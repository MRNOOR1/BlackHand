## Config.in
```kconfig
menu "Black Hand OS"
    source "$BR2_EXTERNAL_BLACKHAND_PATH/tier1-boot/blackhand-init/Config.in"
    source "$BR2_EXTERNAL_BLACKHAND_PATH/tier2-display/blackhand-panel/Config.in"
    source "$BR2_EXTERNAL_BLACKHAND_PATH/tier3-plumbing/blackhand-ipc/Config.in"
    source "$BR2_EXTERNAL_BLACKHAND_PATH/tier3-plumbing/blackhand-storage/Config.in"
    source "$BR2_EXTERNAL_BLACKHAND_PATH/tier4-ui/notcurses/Config.in"
    source "$BR2_EXTERNAL_BLACKHAND_PATH/tier4-ui/blackhand-ui/Config.in"
    source "$BR2_EXTERNAL_BLACKHAND_PATH/tier5-phone/blackhand-audio/Config.in"
    source "$BR2_EXTERNAL_BLACKHAND_PATH/tier5-phone/blackhand-modem/Config.in"
endmenu
```

## tier2-display/blackhand-panel/Config.in
```kconfig
config BR2_PACKAGE_BLACKHAND_PANEL
    bool "blackhand-panel"
    depends on BR2_LINUX_KERNEL
    help
      Init sequence for the Waveshare 1.83" SPI panel. panel.txt is turned
      into panel.bin and linked into the kernel (CONFIG_EXTRA_FIRMWARE),
      because the built-in panel-mipi-dbi driver probes before the rootfs
      is mounted.
```
