## Phase-2/blackhand-external/Config.in
```kconfig
# Entry point for this external tree in menuconfig.
source "${BR2_EXTERNAL_BLACKHAND_PATH}/package/Config.in"
```

## Phase-2/blackhand-external/configs/blackhand_pi5_defconfig
```kconfig
# ============================================================================
# BLACK HAND OS - Raspberry Pi 5 Defconfig
# ============================================================================
# This configuration builds a bootable image for Raspberry Pi 5.
# 
# Usage:
#   make BR2_EXTERNAL=../blackhand-external blackhand_pi5_defconfig
#   make -j$(nproc)
#
# Output: output/images/sdcard.img
# ============================================================================

# ============================================================================
# ARCHITECTURE
# ============================================================================
BR2_aarch64=y
BR2_cortex_a76=y
# Note: BR2_ARM_FPU_VFPV4 is for 32-bit ARM. AArch64 always has FPU.
# Remove it — it's ignored but misleading.

# ============================================================================
# TOOLCHAIN
# ============================================================================
BR2_TOOLCHAIN_BUILDROOT_GLIBC=y
BR2_TOOLCHAIN_BUILDROOT_CXX=y
BR2_KERNEL_HEADERS_6_6=y
BR2_KERNEL_HEADERS_VERSION="6.6"
BR2_PACKAGE_HOST_GDB=y

# ============================================================================
# SYSTEM
# ============================================================================
BR2_TARGET_GENERIC_HOSTNAME="blackhand"
BR2_TARGET_GENERIC_ISSUE="Black Hand OS v0.1"
BR2_TARGET_GENERIC_ROOT_PASSWD="blackhand"
BR2_SYSTEM_DHCP="eth0"
BR2_ROOTFS_DEVICE_CREATION_DYNAMIC_DEVTMPFS=y
BR2_ENABLE_LOCALE_PURGE=y
BR2_SYSTEM_DEFAULT_PATH="/bin:/sbin:/usr/bin:/usr/sbin"

# Use BusyBox init for now — you'll replace this with custom init later
BR2_INIT_BUSYBOX=y

# ============================================================================
# KERNEL
# ============================================================================
BR2_LINUX_KERNEL=y
BR2_LINUX_KERNEL_CUSTOM_TARBALL=y
# Use a SPECIFIC TAG, not a branch, for reproducible builds
BR2_LINUX_KERNEL_CUSTOM_TARBALL_LOCATION="https://github.com/raspberrypi/linux/archive/refs/tags/stable_20241008.tar.gz"
BR2_LINUX_KERNEL_USE_DEFCONFIG=y
BR2_LINUX_KERNEL_DEFCONFIG="bcm2712"

# Kernel image format: Pi 5 uses uncompressed Image
BR2_LINUX_KERNEL_IMAGE=y

# Device Tree
BR2_LINUX_KERNEL_DTS_SUPPORT=y
BR2_LINUX_KERNEL_INTREE_DTS_NAME="broadcom/bcm2712-rpi-5-b"

# Install DTBs to /boot so genimage can find them
BR2_LINUX_KERNEL_INSTALL_TARGET=y

BR2_LINUX_KERNEL_NEEDS_HOST_OPENSSL=y

# ============================================================================
# RASPBERRY PI FIRMWARE (CRITICAL - without this, Pi won't boot)
# ============================================================================
BR2_PACKAGE_RPI_FIRMWARE=y
BR2_PACKAGE_RPI_FIRMWARE_VARIANT_PI4=y
# Note: Pi 5 uses the same firmware variant selection as Pi 4 in Buildroot
# This provides: start4.elf, fixup4.dat, bootcode.bin, etc.

# Install DTB overlays (needed for HyperPixel later)
BR2_PACKAGE_RPI_FIRMWARE_INSTALL_DTB_OVERLAYS=y

# ============================================================================
# TARGET PACKAGES - LIBRARIES
# ============================================================================
BR2_PACKAGE_ALSA_LIB=y
BR2_PACKAGE_ALSA_LIB_PCM=y
BR2_PACKAGE_ALSA_LIB_MIXER=y
BR2_PACKAGE_SQLITE=y
BR2_PACKAGE_CJSON=y
BR2_PACKAGE_LIBMPG123=y

# LVGL with Linux framebuffer backend
BR2_PACKAGE_LVGL=y
BR2_PACKAGE_LVGL_LINUX_FB=y

# ============================================================================
# TARGET PACKAGES - BLUETOOTH
# ============================================================================
BR2_PACKAGE_BLUEZ5_UTILS=y
BR2_PACKAGE_BLUEZ5_UTILS_TOOLS=y
BR2_PACKAGE_BLUEZ_ALSA=y

# ============================================================================
# TARGET PACKAGES - TOOLS (for debugging)
# ============================================================================
BR2_PACKAGE_BUSYBOX=y
BR2_PACKAGE_DROPBEAR=y
BR2_PACKAGE_NANO=y
BR2_PACKAGE_HTOP=y
BR2_PACKAGE_EVTEST=y
BR2_PACKAGE_ALSA_UTILS=y

# Framebuffer test utilities (useful for display debugging)
BR2_PACKAGE_FBV=y

# ============================================================================
# FILESYSTEM
# ============================================================================
BR2_TARGET_ROOTFS_EXT2=y
BR2_TARGET_ROOTFS_EXT2_4=y
BR2_TARGET_ROOTFS_EXT2_SIZE="512M"

# ============================================================================
# HOST TOOLS (for building the SD card image)
# ============================================================================
BR2_PACKAGE_HOST_DOSFSTOOLS=y
BR2_PACKAGE_HOST_GENIMAGE=y
BR2_PACKAGE_HOST_MTOOLS=y

# ============================================================================
# BOARD CUSTOMIZATION (ACTIVE - not commented out)
# ============================================================================
BR2_ROOTFS_OVERLAY="$(BR2_EXTERNAL_BLACKHAND_PATH)/board/blackhand/overlay"
BR2_ROOTFS_POST_BUILD_SCRIPT="$(BR2_EXTERNAL_BLACKHAND_PATH)/board/blackhand/post-build.sh"
BR2_ROOTFS_POST_IMAGE_SCRIPT="$(BR2_EXTERNAL_BLACKHAND_PATH)/board/blackhand/post-image.sh"
```

## Phase-2/blackhand-external/package/Config.in
```kconfig
menu "Black Hand OS packages"
    source "$BR2_EXTERNAL_BLACKHAND_PATH/package/blackhand-init/Config.in"
    source "$BR2_EXTERNAL_BLACKHAND_PATH/package/blackhand-ipc/Config.in"
    source "$BR2_EXTERNAL_BLACKHAND_PATH/package/blackhand-audio/Config.in"
    source "$BR2_EXTERNAL_BLACKHAND_PATH/package/blackhand-modem/Config.in"
    source "$BR2_EXTERNAL_BLACKHAND_PATH/package/blackhand-stt/Config.in"
    source "$BR2_EXTERNAL_BLACKHAND_PATH/package/blackhand-storage/Config.in"
    source "$BR2_EXTERNAL_BLACKHAND_PATH/package/blackhand-ui/Config.in"
endmenu
```

## Phase-2/blackhand-external/package/blackhand-ipc/Config.in
```kconfig
config BR2_PACKAGE_BLACKHAND_IPC
    bool "blackhand-ipc"
    help
      Shared IPC library for Unix domain sockets and JSON-RPC.
      This package should install a static or shared lib for services.
```

## Phase-2/blackhand-external/package/blackhand-modem/Config.in
```kconfig
config BR2_PACKAGE_BLACKHAND_MODEM
    bool "blackhand-modem"
    help
      Modem service for calls and SMS via AT commands.
```

## Phase-2/blackhand-external/package/blackhand-stt/Config.in
```kconfig
config BR2_PACKAGE_BLACKHAND_STT
    bool "blackhand-stt"
    help
      Speech-to-text service using Vosk or Whisper.cpp.
```
