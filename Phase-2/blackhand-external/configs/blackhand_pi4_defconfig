## Phase-2/blackhand-external/package/blackhand-audio/Config.in
```kconfig
config BR2_PACKAGE_BLACKHAND_AUDIO
    bool "blackhand-audio"
    select BR2_PACKAGE_ALSA_LIB
    help
      Audio service: routing, ALSA control, playback helpers.
      Depends on ALSA.
```

## Phase-2/blackhand-external/package/blackhand-init/Config.in
```kconfig
config BR2_PACKAGE_BLACKHAND_INIT
    bool "blackhand-init"
    help
      Custom PID 1 init for Black Hand OS.
      Implement process reaping, mount setup, and service manager spawn.

config BR2_PACKAGE_BLACKHAND_INIT_DEBUG_SHELL
    bool "debug shell on tty2 (INSECURE - bring-up only)"
    depends on BR2_PACKAGE_BLACKHAND_INIT
    help
      Spawn an UNAUTHENTICATED root shell on /dev/tty2, reachable with
      Alt+F2 (the UI owns tty1). It respawns if you exit it, so it cannot
      be lost mid-session.

      This bypasses the app PIN and every other access control, and is the
      rescue path when SSH is unavailable.

      NEVER enable this in a production image.
```

## Phase-2/blackhand-external/package/blackhand-lora/Config.in
```kconfig
config BR2_PACKAGE_BLACKHAND_LORA
    bool "blackhand-lora"
    select BR2_PACKAGE_BLACKHAND_IPC
    help
      LoRa text messaging service. Drives an Adafruit RFM95W
      (Semtech SX1276) transceiver over /dev/spidev0.1 (SPI0 CE1)
      and exposes send/receive over /run/bh-lora.sock.

      Point-to-point broadcast text only (no addressing, ACK, or
      encryption in this MVP). Requires CONFIG_SPI_SPIDEV in the
      kernel and the RFM95 wired to SPI0 CE1 + RST on GPIO26.
```

## Phase-2/blackhand-external/package/blackhand-storage/Config.in
```kconfig
config BR2_PACKAGE_BLACKHAND_STORAGE
    bool "blackhand-storage"
    help
      Storage service for contacts, SMS, settings (JSON files, no SQLite).
```

## Phase-2/blackhand-external/package/blackhand-ui/Config.in
```kconfig
config BR2_PACKAGE_BLACKHAND_UI
    bool "blackhand-ui"
    select BR2_PACKAGE_NOTCURSES
    select BR2_PACKAGE_MPG123
    select BR2_PACKAGE_ALSA_LIB
    select BR2_PACKAGE_ALSA_UTILS
    help
      Notcurses TUI application for Black Hand OS.
```

## Phase-2/blackhand-external/package/hyperpixel4-init/Config.in
```kconfig
config BR2_PACKAGE_HYPERPIXEL4_INIT
    bool "hyperpixel4-init"
    help
      Sends the SPI init sequence to the HyperPixel 4.0 LCD controller
      via GPIO bit-bang. Required to wake the panel when using firmware
      DPI framebuffer (not KMS).
```

## Phase-2/blackhand-external/package/notcurses/Config.in
```kconfig
config BR2_PACKAGE_NOTCURSES
    bool "notcurses"
    depends on BR2_TOOLCHAIN_HAS_THREADS
    select BR2_PACKAGE_NCURSES
    select BR2_PACKAGE_NCURSES_WCHAR
    select BR2_PACKAGE_LIBUNISTRING
    select BR2_PACKAGE_LIBDEFLATE
    select BR2_PACKAGE_GPM
    help
      Notcurses is a library facilitating complex TUIs on modern
      terminal emulators and the Linux console, supporting vivid
      colors, multimedia, threads, and Unicode.
      GPM is enabled for touchscreen/mouse support on fbcon.

      https://github.com/dankamongmen/notcurses
```
